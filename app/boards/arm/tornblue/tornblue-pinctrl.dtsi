&pinctrl {
    spi1_default: spi1_default {
        group1 {
            psels = <NRF_PSEL(SPIM_SCK, 1, 6)>,
                <NRF_PSEL(SPIM_MOSI, 0, 23)>,
                <NRF_PSEL(SPIM_MISO, 1, 8)>;
        };
    };
};
